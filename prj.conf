## CMakeLists.txt
```
# SPDX-License-Identifier: Apache-2.0

cmake_minimum_required(VERSION 3.20.0)

find_package(Zephyr REQUIRED HINTS $ENV{ZEPHYR_BASE})
project(embed-sandbox)

target_sources(app PRIVATE
    src/main.c
    src/uart_manager.c
    src/generator.c
    src/shell_commands.c
    src/scenarios.c
    src/statistics.c
)
```

## prj.conf
```kconfig
# SPDX-License-Identifier: Apache-2.0

# Serial
CONFIG_SERIAL=y
CONFIG_UART_INTERRUPT_DRIVEN=y

# Console
CONFIG_CONSOLE=y
CONFIG_UART_CONSOLE=y

# Shell
CONFIG_SHELL=y
CONFIG_SHELL_BACKEND_SERIAL=y

# Logging
CONFIG_LOG=y
CONFIG_LOG_MODE_IMMEDIATE=y
CONFIG_LOG_BACKEND_UART=y
CONFIG_LOG_PRINTK=y

# GPIO
CONFIG_GPIO=y

# Random (needed by scenarios using random payloads)
CONFIG_TEST_RANDOM_GENERATOR=y
```

## boards/native_sim.conf
```kconfig
# Board-specific Kconfig overrides for native_sim_64
# Remove STM32-specific options not available on native POSIX target

CONFIG_UART_INTERRUPT_DRIVEN=n
CONFIG_GPIO=n
```

## boards/native_sim.overlay
```dts
/* SPDX-License-Identifier: Apache-2.0 */
/* Overlay for native_sim_64 — adds virtual UARTs for testing */

/ {
	/* Virtual generator UART #1 — maps to a pseudo-terminal */
	usart1: uart_v1 {
		status = "okay";
		compatible = "zephyr,native-pty-uart";
		current-speed = <115200>;
	};
	/* Virtual generator UART #2 */
	usart3: uart_v3 {
		status = "okay";
		compatible = "zephyr,native-pty-uart";
		current-speed = <115200>;
	};
	/* Virtual generator UART #3 */
	usart4: uart_v4 {
		status = "okay";
		compatible = "zephyr,native-pty-uart";
		current-speed = <115200>;
	};
};
```

## boards/nucleo_g070rb.overlay
```dts
/* SPDX-License-Identifier: Apache-2.0 */

/* Enable USART3 (PD8/PD9) - External FTDI #2 */
&usart3 {
	pinctrl-0 = <&usart3_tx_pd8 &usart3_rx_pd9>;
	pinctrl-names = "default";
	current-speed = <115200>;
	status = "okay";
};

/* Enable USART4 (PA0/PA1) - External FTDI #3 */
&usart4 {
	pinctrl-0 = <&usart4_tx_pa0 &usart4_rx_pa1>;
	pinctrl-names = "default";
	current-speed = <115200>;
	status = "okay";
};
```

## src/main.c
```c
/*
 * SPDX-License-Identifier: Apache-2.0
 *
 * embed-sandbox — STM32 UART log generator
 *
 * Generates configurable UART log traffic on multiple interfaces
 * to exercise a desktop log collection tool.
 */

#include "uart_manager.h"
#include <zephyr/kernel.h>
#include <zephyr/device.h>
#include <zephyr/devicetree.h>
#include <zephyr/drivers/uart.h>
#include <zephyr/logging/log.h>

LOG_MODULE_REGISTER(main, CONFIG_LOG_DEFAULT_LEVEL);


int main(void)
{
	LOG_INF("Embed-sandbox starting (board: %s)", CONFIG_BOARD);

	printk("\n=== embed-sandbox ===\n");
	printk("Board: %s\n", CONFIG_BOARD);
	printk("Type 'help' for available commands.\n\n");

	int err = uart_manager_init();
	if (err) {
		LOG_WRN("%d generator UART(s) not available", err);
	}

	/* Brief TX test on each enabled generator UART */
	for (enum uart_id id = UART_GEN1; id < UART_COUNT; id++) {
		const struct uart_port *port = uart_get(id);
		if (!port || !port->enabled) {
			continue;
		}
		char msg[64];
		int len = snprintk(msg, sizeof(msg),
				  "[%s] Generator online\r\n",
				  port->label);
		if (len > 0) {
			uart_send(id, (const uint8_t *)msg, len);
		}
	}

	while (1) {
		k_sleep(K_SECONDS(1));
	}

	return 0;
}
```

## src/generator.c
```c
/*
 * SPDX-License-Identifier: Apache-2.0
 *
 * embed-sandbox — Log generator implementation
 *
 * Each configured USART (USART1, USART3, USART4) gets a dedicated
 * thread that periodically formats and transmits a log message via
 * the UART manager.
 */

#include "generator.h"
#include "uart_manager.h"

#include <zephyr/kernel.h>
#include <zephyr/sys/printk.h>

/* ------------------------------------------------------------------
 * UART label strings — must match the names in the devicetree overlay.
 * ------------------------------------------------------------------ */
static const char *const gen_labels[GEN_COUNT] = {
	"USART1",
	"USART3",
	"USART4",
};

/* ------------------------------------------------------------------
 * Thread stacks — one per generator, statically allocated.
 * ------------------------------------------------------------------ */
#define GEN_STACK_SIZE 1024

K_THREAD_STACK_DEFINE(gen_stack_0, GEN_STACK_SIZE);
K_THREAD_STACK_DEFINE(gen_stack_1, GEN_STACK_SIZE);
K_THREAD_STACK_DEFINE(gen_stack_2, GEN_STACK_SIZE);

/* Stack pointer + size per generator */
static const struct {
	k_thread_stack_t *buf;
	size_t            size;
} gen_stacks[GEN_COUNT] = {
	{ .buf = gen_stack_0, .size = K_THREAD_STACK_SIZEOF(gen_stack_0) },
	{ .buf = gen_stack_1, .size = K_THREAD_STACK_SIZEOF(gen_stack_1) },
	{ .buf = gen_stack_2, .size = K_THREAD_STACK_SIZEOF(gen_stack_2) },
};

/* Per-generator state array */
static struct gen_state gen_states[GEN_COUNT];

/* Thread priority (low preemptible — shell/main runs at higher prio) */
#define GEN_THREAD_PRIO 5

/* ------------------------------------------------------------------
 * Generator thread
 * ------------------------------------------------------------------ */

static void gen_thread_fn(void *arg1, void *arg2, void *arg3)
{
	struct gen_state *state = (struct gen_state *)arg1;
	enum gen_id id = (enum gen_id)(state - gen_states);
	char buf[256];

	while (state->cfg.enabled) {
		/* Block for interval or until woken by gen_stop */
		k_sem_take(&state->wake, K_MSEC(state->cfg.interval_ms));

		if (!state->cfg.enabled) {
			break;
		}

		/* Format message according to template */
		int len;

		switch (state->cfg.template_id) {
		case 1:
			len = snprintk(buf, sizeof(buf),
				      "[%s] DATA Packet %llu\r\n",
				      gen_labels[id],
				      (unsigned long long)state->counter);
			break;
		case 2:
			len = snprintk(buf, sizeof(buf),
				      "[%s] DEBUG Value=%llu\r\n",
				      gen_labels[id],
				      (unsigned long long)state->counter);
			break;
		case 0:
		default:
			len = snprintk(buf, sizeof(buf),
				      "[%s] INFO Counter=%llu\r\n",
				      gen_labels[id],
				      (unsigned long long)state->counter);
			break;
		}

		/* Clamp to configured msg_size if set */
		if (state->cfg.msg_size > 0 &&
		    len > (int)state->cfg.msg_size) {
			len = state->cfg.msg_size;
		}

		/* Transmit via UART manager */
		uart_send((enum uart_id)id,
			  (const uint8_t *)buf, (size_t)len);

		state->counter++;
	}
}

/* ------------------------------------------------------------------
 * Public API
 * ------------------------------------------------------------------ */

int gen_init(void)
{
	for (int i = 0; i < GEN_COUNT; i++) {
		struct gen_state *s = &gen_states[i];

		s->counter = 0;
		s->cfg.enabled      = false;
		s->cfg.interval_ms  = 1000;
		s->cfg.msg_size     = 0;
		s->cfg.template_id  = 0;
		s->cfg.random_mode  = false;

		k_sem_init(&s->wake, 0, 1);
	}

	return 0;
}

int gen_start(enum gen_id id)
{
	if ((int)id < 0 || id >= GEN_COUNT) {
		return -EINVAL;
	}

	struct gen_state *s = &gen_states[id];

	if (s->cfg.enabled) {
		return -EALREADY;
	}

	s->counter = 0;
	s->cfg.enabled = true;

	k_thread_create(&s->thread,
			gen_stacks[id].buf,
			gen_stacks[id].size,
			(k_thread_entry_t)gen_thread_fn,
			(void *)s,
			NULL,
			NULL,
			GEN_THREAD_PRIO,
			0,
			K_NO_WAIT);

	return 0;
}

int gen_stop(enum gen_id id)
{
	if ((int)id < 0 || id >= GEN_COUNT) {
		return -EINVAL;
	}

	struct gen_state *s = &gen_states[id];

	if (!s->cfg.enabled) {
		return -EALREADY;
	}

	s->cfg.enabled = false;
	k_sem_give(&s->wake);

	k_thread_join(&s->thread, K_FOREVER);

	return 0;
}

int gen_set_interval(enum gen_id id, uint32_t ms)
{
	if ((int)id < 0 || id >= GEN_COUNT) {
		return -EINVAL;
	}
	if (ms == 0) {
		return -EINVAL;
	}

	gen_states[id].cfg.interval_ms = ms;
	return 0;
}

int gen_set_size(enum gen_id id, uint16_t bytes)
{
	if ((int)id < 0 || id >= GEN_COUNT) {
		return -EINVAL;
	}

	gen_states[id].cfg.msg_size = bytes;
	return 0;
}

int gen_set_random(enum gen_id id, bool on)
{
	if ((int)id < 0 || id >= GEN_COUNT) {
		return -EINVAL;
	}

	gen_states[id].cfg.random_mode = on;
	return 0;
}
```

## src/generator.h
```c
/*
 * SPDX-License-Identifier: Apache-2.0
 *
 * embed-sandbox — Log generator core API
 */

#ifndef GENERATOR_H
#define GENERATOR_H

#include <stdint.h>
#include <stdbool.h>
#include <zephyr/kernel.h>

/** Generator logical IDs — mirrors uart_id from uart_manager.h */
enum gen_id {
	GEN1 = 0,  /**< USART1 */
	GEN2,      /**< USART3 */
	GEN3,      /**< USART4 */
	GEN_COUNT
};

/** Per-generator configuration parameters */
struct gen_config {
	bool     enabled;
	uint32_t interval_ms;
	uint16_t msg_size;
	uint8_t  template_id;
	bool     random_mode;
};

/** Per-generator runtime state */
struct gen_state {
	uint64_t         counter;
	struct gen_config cfg;
	struct k_thread  thread;
	struct k_sem     wake;
};

/**
 * Initialize all generators to default (disabled) state.
 *
 * Must be called once before any other generator API.  Assumes
 * uart_manager_init() has already succeeded.
 *
 * @retval 0 on success
 */
int gen_init(void);

/**
 * Start a generator thread.
 *
 * The thread runs until stopped via gen_stop().  Calling start on an
 * already-running generator is an error.
 *
 * @param id  generator logical ID
 * @retval 0 on success
 * @retval -EINVAL invalid id
 * @retval -EALREADY generator is already running
 */
int gen_start(enum gen_id id);

/**
 * Stop a generator thread and wait for it to exit.
 *
 * @param id  generator logical ID
 * @retval 0 on success
 * @retval -EINVAL invalid id
 * @retval -EALREADY generator is not running
 */
int gen_stop(enum gen_id id);

/**
 * Set the transmit interval for a generator.
 *
 * @param id  generator logical ID
 * @param ms  interval in milliseconds (must be > 0)
 * @retval 0 on success
 * @retval -EINVAL invalid id or ms == 0
 */
int gen_set_interval(enum gen_id id, uint32_t ms);

/**
 * Set the maximum message size for a generator.
 *
 * Size 0 means no limit (use the full formatted message).
 *
 * @param id    generator logical ID
 * @param bytes maximum message length in bytes
 * @retval 0 on success
 * @retval -EINVAL invalid id
 */
int gen_set_size(enum gen_id id, uint16_t bytes);

/**
 * Enable or disable random mode for a generator.
 *
 * Random mode is reserved for future scenario use; currently a no-op in
 * the thread format logic.
 *
 * @param id  generator logical ID
 * @param on  true to enable, false to disable
 * @retval 0 on success
 * @retval -EINVAL invalid id
 */
int gen_set_random(enum gen_id id, bool on);

#endif /* GENERATOR_H */
```

## src/scenarios.c
```c
/*
 * SPDX-License-Identifier: Apache-2.0
 *
 * Predefined test scenarios for UART log generation.
 */

#include "scenarios.h"
#include "generator.h"
#include "uart_manager.h"

#include <zephyr/kernel.h>
#include <zephyr/random/random.h>
#include <zephyr/sys/util.h>
#include <errno.h>
#include <string.h>

/* ------------------------------------------------------------------
 * Internal state
 * ------------------------------------------------------------------ */

static bool scenario_running;

/* ------------------------------------------------------------------
 * Baud-switching thread resources
 * ------------------------------------------------------------------ */

#define BAUD_SWITCH_STACK_SIZE 1024

K_THREAD_STACK_DEFINE(baud_switch_stack, BAUD_SWITCH_STACK_SIZE);
static struct k_thread baud_switch_thread;

/* ------------------------------------------------------------------
 * Scenario name table
 * ------------------------------------------------------------------ */

static const char * const scenario_names[] = {
	"continuous",
	"burst",
	"random",
	"high-throughput",
	"mixed",
	"baud-switching",
};

#define NUM_SCENARIOS ARRAY_SIZE(scenario_names)

/* ------------------------------------------------------------------
 * Helpers
 * ------------------------------------------------------------------ */

static void start_all_generators(void)
{
	for (enum gen_id id = GEN1; id < GEN_COUNT; id++) {
		gen_start(id);
	}
}

static void stop_all_generators(void)
{
	for (enum gen_id id = GEN1; id < GEN_COUNT; id++) {
		gen_stop(id);
	}
}

/* ------------------------------------------------------------------
 * Baud-switching thread
 * ------------------------------------------------------------------ */

static void baud_switch_fn(void *arg1, void *arg2, void *arg3)
{
	ARG_UNUSED(arg1);
	ARG_UNUSED(arg2);
	ARG_UNUSED(arg3);

	static const uint32_t baud_rates[] = {
		9600, 19200, 38400, 57600, 115200, 230400, 460800, 921600,
	};

	while (scenario_running) {
		for (size_t i = 0; i < ARRAY_SIZE(baud_rates) && scenario_running; i++) {
			for (enum uart_id id = UART_GEN1; id < UART_COUNT; id++) {
				uart_set_baud(id, baud_rates[i]);
			}
			k_sleep(K_SECONDS(3));
		}
	}
}

/* ------------------------------------------------------------------
 * Public API
 * ------------------------------------------------------------------ */

int scenario_run(const char *name)
{
	if (!name) {
		return -EINVAL;
	}

	/* Stop any scenario that is already running */
	if (scenario_running) {
		scenario_stop();
	}

	if (strcmp(name, "continuous") == 0) {
		/* All generators: interval=1000ms, size=64, random=off */
		for (enum gen_id id = GEN1; id < GEN_COUNT; id++) {
			gen_set_interval(id, 1000);
			gen_set_size(id, 64);
			gen_set_random(id, false);
		}
		scenario_running = true;
		start_all_generators();

	} else if (strcmp(name, "burst") == 0) {
		/* All generators: interval=10ms, size=128, run 5s then stop */
		for (enum gen_id id = GEN1; id < GEN_COUNT; id++) {
			gen_set_interval(id, 10);
			gen_set_size(id, 128);
		}
		scenario_running = true;
		start_all_generators();

		k_sleep(K_SECONDS(5));

		stop_all_generators();
		scenario_running = false;

	} else if (strcmp(name, "random") == 0) {
		/* Each generator: random interval 50..549ms, size 32..287, random=on */
		for (enum gen_id id = GEN1; id < GEN_COUNT; id++) {
			uint32_t r = sys_rand32_get();
			uint32_t interval = (r % 500U) + 50;
			uint16_t size = (uint16_t)((r >> 16) % 256U) + 32;

			gen_set_interval(id, interval);
			gen_set_size(id, size);
			gen_set_random(id, true);
		}
		scenario_running = true;
		start_all_generators();

	} else if (strcmp(name, "high-throughput") == 0) {
		/* All generators: interval=10ms, size=256 */
		for (enum gen_id id = GEN1; id < GEN_COUNT; id++) {
			gen_set_interval(id, 10);
			gen_set_size(id, 256);
		}
		scenario_running = true;
		start_all_generators();

	} else if (strcmp(name, "mixed") == 0) {
		/* Per-UART custom settings */
		uart_set_baud(UART_GEN1, 9600);
		gen_set_interval(GEN1, 2000);
		gen_set_size(GEN1, 32);

		uart_set_baud(UART_GEN2, 115200);
		gen_set_interval(GEN2, 500);
		gen_set_size(GEN2, 64);

		uart_set_baud(UART_GEN3, 921600);
		gen_set_interval(GEN3, 100);
		gen_set_size(GEN3, 128);

		scenario_running = true;
		start_all_generators();

	} else if (strcmp(name, "baud-switching") == 0) {
		/* Moderate settings, then cycle baud rates in a thread */
		for (enum gen_id id = GEN1; id < GEN_COUNT; id++) {
			gen_set_interval(id, 100);
			gen_set_size(id, 64);
		}

		scenario_running = true;
		start_all_generators();

		k_thread_create(&baud_switch_thread, baud_switch_stack,
				K_THREAD_STACK_SIZEOF(baud_switch_stack),
				baud_switch_fn, NULL, NULL, NULL,
				5, 0, K_NO_WAIT);

	} else {
		return -EINVAL;
	}

	return 0;
}

int scenario_stop(void)
{
	scenario_running = false;
	stop_all_generators();
	return 0;
}

const char * const *scenario_list(int *count)
{
	if (count) {
		*count = NUM_SCENARIOS;
	}
	return scenario_names;
}
```

## src/scenarios.h
```c
/*
 * SPDX-License-Identifier: Apache-2.0
 *
 * Predefined test scenarios.
 */

#ifndef SCENARIOS_H
#define SCENARIOS_H

#ifdef __cplusplus
extern "C" {
#endif

/**
 * @brief Run a named scenario.
 *
 * Stops any currently running scenario first, configures generators and
 * UARTs per the scenario definition, and starts the generators.
 *
 * @param name  Scenario name (see @ref scenario_list).
 *
 * @retval 0 on success.
 * @retval -EINVAL if @p name is NULL or unknown.
 */
int scenario_run(const char *name);

/**
 * @brief Stop the currently running scenario.
 *
 * Sets the running flag false, stops all generators, and resets internal
 * state.  Safe to call even when no scenario is running.
 *
 * @retval 0 always.
 */
int scenario_stop(void);

/**
 * @brief Return the list of available scenario names.
 *
 * @param[out] count  Set to the number of entries in the returned array.
 *
 * @return Pointer to a NULL-terminated array of scenario name strings.
 */
const char * const *scenario_list(int *count);

#ifdef __cplusplus
}
#endif

#endif /* SCENARIOS_H */
```

## src/shell_commands.c
```c
/*
 * SPDX-License-Identifier: Apache-2.0
 *
 * Shell commands for UART config, generator control, scenarios, and stats.
 *
 * Top-level commands:
 *   uart      — list / <id> baud|enable|disable
 *   gen       — start|stop|interval|size|random
 *   scenario  — list|run|stop
 *   stats     — [<id>]
 */

#include "shell_commands.h"

#include "uart_manager.h"
#include "generator.h"
#include "statistics.h"
#include "scenarios.h"

#include <zephyr/shell/shell.h>
#include <zephyr/sys/printk.h>

#include <errno.h>
#include <stdlib.h>
#include <string.h>

/* ------------------------------------------------------------------
 * Forward declarations for APIs not yet provided by sibling headers.
 * These match the contracts the StatisticsModule and ScenariosModule
 * will implement.
 * ------------------------------------------------------------------ */

/* statistics.c */
void stats_print_all(void);
void stats_print(enum uart_id id);

/* scenarios.c */
const char * const *scenario_list(int *count);
int  scenario_run(const char *name);
int  scenario_stop(void);

/* ------------------------------------------------------------------
 * ID-string helpers
 * ------------------------------------------------------------------ */

/**
 * @brief Convert a shell UART name to an enum uart_id.
 *
 * Accepts "uart1", "uart3", "uart4".  Returns -1 on invalid input.
 */
static int str_to_uart_id(const char *str)
{
	if (strcmp(str, "uart1") == 0) {
		return UART_GEN1;
	}
	if (strcmp(str, "uart3") == 0) {
		return UART_GEN2;
	}
	if (strcmp(str, "uart4") == 0) {
		return UART_GEN3;
	}
	return -1;
}

/**
 * @brief Convert a shell UART name to an enum gen_id.
 *
 * Accepts "uart1", "uart3", "uart4".  Returns -1 on invalid input.
 */
static int str_to_gen_id(const char *str)
{
	if (strcmp(str, "uart1") == 0) {
		return GEN1;
	}
	if (strcmp(str, "uart3") == 0) {
		return GEN2;
	}
	if (strcmp(str, "uart4") == 0) {
		return GEN3;
	}
	return -1;
}

/**
 * @brief Return the user-facing name for a uart_id.
 */
static const char *uart_id_name(enum uart_id id)
{
	switch (id) {
	case UART_GEN1: return "uart1";
	case UART_GEN2: return "uart3";
	case UART_GEN3: return "uart4";
	default:        return "?";
	}
}

/* ==================================================================
 * uart command
 * ================================================================== */

static int cmd_uart_list(const struct shell *sh, size_t argc, char **argv)
{
	(void)argc;
	(void)argv;

	shell_print(sh, "%-6s %-7s %-12s %s", "ID", "Status", "Baud", "Device");
	shell_print(sh, "------ ------- ------------ -------");

	for (enum uart_id id = UART_GEN1; id < UART_COUNT; id++) {
		const struct uart_port *port = uart_get(id);
		if (port == NULL) {
			continue;
		}
		shell_print(sh, "%-6s %-7s %-12u %s",
			    uart_id_name(id),
			    port->enabled ? "ENABLED" : "DISABLED",
			    (unsigned int)port->baudrate,
			    port->label);
	}

	return 0;
}

static int cmd_uart_id(const struct shell *sh, size_t argc, char **argv)
{
	/* argv[-1] is the subcommand name (one of "uart1", "uart3", "uart4") */
	const char *id_str = argv[-1];
	int id = str_to_uart_id(id_str);
	if (id < 0) {
		shell_error(sh, "Internal error: unknown subcommand '%s'", id_str);
		return -EINVAL;
	}

	if (argc < 1) {
		shell_error(sh, "Missing action (baud <val>, enable, disable)");
		return -EINVAL;
	}

	const char *action = argv[0];

	if (strcmp(action, "baud") == 0) {
		if (argc < 2) {
			shell_error(sh, "Missing baud rate value");
			return -EINVAL;
		}

		unsigned long baud = strtoul(argv[1], NULL, 10);
		if (baud < 9600 || baud > 921600) {
			shell_error(sh, "Baud rate %lu out of range (9600-921600)",
				    baud);
			return -EINVAL;
		}

		int ret = uart_set_baud((enum uart_id)id, (uint32_t)baud);
		if (ret < 0) {
			shell_error(sh, "Failed to set baud rate: %d", ret);
			return ret;
		}

		shell_info(sh, "%s baud rate set to %lu", id_str, baud);
		return 0;
	}

	if (strcmp(action, "enable") == 0) {
		int ret = uart_enable((enum uart_id)id);
		if (ret < 0) {
			shell_error(sh, "Failed to enable %s: %d", id_str, ret);
			return ret;
		}
		shell_info(sh, "%s enabled", id_str);
		return 0;
	}

	if (strcmp(action, "disable") == 0) {
		int ret = uart_disable((enum uart_id)id);
		if (ret < 0) {
			shell_error(sh, "Failed to disable %s: %d", id_str, ret);
			return ret;
		}
		shell_info(sh, "%s disabled", id_str);
		return 0;
	}

	shell_error(sh, "Unknown action: '%s' (expected baud <val>, enable, or disable)",
		    action);
	return -EINVAL;
}

SHELL_STATIC_SUBCMD_SET_CREATE(sub_uart,
	SHELL_CMD(list, NULL, "List all generator UARTs with status and baud rate",
		  cmd_uart_list),
	SHELL_CMD_ARG(uart1, NULL,
		      "Configure UART1: baud <val>, enable, disable",
		      cmd_uart_id, 1, 2),
	SHELL_CMD_ARG(uart3, NULL,
		      "Configure UART3: baud <val>, enable, disable",
		      cmd_uart_id, 1, 2),
	SHELL_CMD_ARG(uart4, NULL,
		      "Configure UART4: baud <val>, enable, disable",
		      cmd_uart_id, 1, 2),
	SHELL_SUBCMD_SET_END
);

SHELL_CMD_REGISTER(uart, &sub_uart, "Generator UART configuration", NULL);

/* ==================================================================
 * gen command
 * ================================================================== */

static int cmd_gen_uart(const struct shell *sh, size_t argc, char **argv)
{
	const char *id_str = argv[-1];
	int id = str_to_gen_id(id_str);
	if (id < 0) {
		shell_error(sh, "Internal error: unknown subcommand '%s'", id_str);
		return -EINVAL;
	}

	if (argc < 1) {
		shell_error(sh, "Missing action (start, stop, interval, size, random)");
		return -EINVAL;
	}

	const char *action = argv[0];

	if (strcmp(action, "start") == 0) {
		int ret = gen_start((enum gen_id)id);
		if (ret < 0) {
			shell_error(sh, "Failed to start generator on %s: %d",
				    id_str, ret);
			return ret;
		}
		shell_info(sh, "Generator started on %s", id_str);
		return 0;
	}

	if (strcmp(action, "stop") == 0) {
		int ret = gen_stop((enum gen_id)id);
		if (ret < 0) {
			shell_error(sh, "Failed to stop generator on %s: %d",
				    id_str, ret);
			return ret;
		}
		shell_info(sh, "Generator stopped on %s", id_str);
		return 0;
	}

	if (strcmp(action, "interval") == 0) {
		if (argc < 2) {
			shell_error(sh, "Missing interval value (ms)");
			return -EINVAL;
		}

		unsigned long ms = strtoul(argv[1], NULL, 10);
		if (ms < 10) {
			shell_error(sh, "Interval %lu ms too low (minimum 10)", ms);
			return -EINVAL;
		}

		int ret = gen_set_interval((enum gen_id)id, (uint32_t)ms);
		if (ret < 0) {
			shell_error(sh, "Failed to set interval on %s: %d",
				    id_str, ret);
			return ret;
		}

		shell_info(sh, "%s interval set to %lu ms", id_str, ms);
		return 0;
	}

	if (strcmp(action, "size") == 0) {
		if (argc < 2) {
			shell_error(sh, "Missing size value (bytes)");
			return -EINVAL;
		}

		unsigned long bytes = strtoul(argv[1], NULL, 10);
		if (bytes < 16 || bytes > 512) {
			shell_error(sh, "Size %lu out of range (16-512)", bytes);
			return -EINVAL;
		}

		int ret = gen_set_size((enum gen_id)id, (uint16_t)bytes);
		if (ret < 0) {
			shell_error(sh, "Failed to set size on %s: %d",
				    id_str, ret);
			return ret;
		}

		shell_info(sh, "%s message size set to %lu bytes", id_str, bytes);
		return 0;
	}

	if (strcmp(action, "random") == 0) {
		if (argc < 2) {
			shell_error(sh, "Missing value: on or off");
			return -EINVAL;
		}

		bool on;
		if (strcmp(argv[1], "on") == 0) {
			on = true;
		} else if (strcmp(argv[1], "off") == 0) {
			on = false;
		} else {
			shell_error(sh, "Invalid random value '%s' (expected on or off)",
				    argv[1]);
			return -EINVAL;
		}

		int ret = gen_set_random((enum gen_id)id, on);
		if (ret < 0) {
			shell_error(sh, "Failed to set random mode on %s: %d",
				    id_str, ret);
			return ret;
		}

		shell_info(sh, "%s random mode %s", id_str, on ? "on" : "off");
		return 0;
	}

	shell_error(sh, "Unknown action: '%s' (expected start, stop, interval, "
		    "size, or random)", action);
	return -EINVAL;
}

SHELL_STATIC_SUBCMD_SET_CREATE(sub_gen,
	SHELL_CMD_ARG(uart1, NULL,
		      "Control generator on UART1: start, stop, interval <ms>, "
		      "size <bytes>, random on|off",
		      cmd_gen_uart, 1, 2),
	SHELL_CMD_ARG(uart3, NULL,
		      "Control generator on UART3: start, stop, interval <ms>, "
		      "size <bytes>, random on|off",
		      cmd_gen_uart, 1, 2),
	SHELL_CMD_ARG(uart4, NULL,
		      "Control generator on UART4: start, stop, interval <ms>, "
		      "size <bytes>, random on|off",
		      cmd_gen_uart, 1, 2),
	SHELL_SUBCMD_SET_END
);

SHELL_CMD_REGISTER(gen, &sub_gen, "Log generator control", NULL);

/* ==================================================================
 * scenario command
 * ================================================================== */

static int cmd_scenario_list(const struct shell *sh, size_t argc, char **argv)
{
	(void)argc;
	(void)argv;

	int count;
	const char * const *names = scenario_list(&count);

	shell_print(sh, "Available scenarios (%d):", count);
	for (int i = 0; i < count; i++) {
		shell_print(sh, "  %s", names[i]);
	}
	return 0;
}

static int cmd_scenario_run(const struct shell *sh, size_t argc, char **argv)
{
	(void)argc;

	const char *name = argv[0];
	int ret = scenario_run(name);
	if (ret < 0) {
		shell_error(sh, "Failed to run scenario '%s': %d", name, ret);
		return ret;
	}

	shell_info(sh, "Scenario '%s' started", name);
	return 0;
}

static int cmd_scenario_stop(const struct shell *sh, size_t argc, char **argv)
{
	(void)argc;
	(void)argv;

	int ret = scenario_stop();
	if (ret < 0) {
		shell_error(sh, "Failed to stop scenario: %d", ret);
		return ret;
	}

	shell_info(sh, "Scenario stopped");
	return 0;
}

SHELL_STATIC_SUBCMD_SET_CREATE(sub_scenario,
	SHELL_CMD(list, NULL, "List available test scenarios",
		  cmd_scenario_list),
	SHELL_CMD_ARG(run, NULL, "Run a named scenario", cmd_scenario_run, 1, 1),
	SHELL_CMD(stop, NULL, "Stop the currently running scenario",
		  cmd_scenario_stop),
	SHELL_SUBCMD_SET_END
);

SHELL_CMD_REGISTER(scenario, &sub_scenario, "Test scenario control", NULL);

/* ==================================================================
 * stats command
 * ================================================================== */

static int cmd_stats(const struct shell *sh, size_t argc, char **argv)
{
	if (argc == 0) {
		stats_print_all();
		return 0;
	}

	int id = str_to_uart_id(argv[0]);
	if (id < 0) {
		shell_error(sh, "Unknown UART: '%s' (expected uart1, uart3, or uart4)",
			    argv[0]);
		return -EINVAL;
	}

	stats_print((enum uart_id)id);
	return 0;
}

SHELL_CMD_ARG_REGISTER(stats, NULL, "Show UART statistics", cmd_stats, 0, 1);
```

## src/shell_commands.h
```c
/*
 * SPDX-License-Identifier: Apache-2.0
 *
 * Shell commands — UART config, generator control, scenarios, stats.
 */

#ifndef SHELL_COMMANDS_H
#define SHELL_COMMANDS_H

/* All commands register themselves via SHELL_CMD_REGISTER /
 * SHELL_CMD_ARG_REGISTER at build time; no explicit initialisation
 * routine is required.
 */

#endif /* SHELL_COMMANDS_H */
```

## src/statistics.c
```c
/*
 * SPDX-License-Identifier: Apache-2.0
 *
 * Per-UART runtime statistics.
 */

#include "statistics.h"

#include <zephyr/kernel.h>
#include <zephyr/sys/printk.h>

/* ------------------------------------------------------------------
 * Per-UART statistics state
 * --------------------------------------------------------------- */

struct stats_entry {
	uint64_t tx_bytes;
	uint64_t tx_messages;
	uint64_t dropped;
	uint32_t start_time;	/* k_uptime_get() value of first TX; 0 = not started */
	uint32_t baudrate;
};

static struct stats_entry stats[UART_COUNT];

/* ------------------------------------------------------------------
 * Public API
 * --------------------------------------------------------------- */

void stats_init(void)
{
	for (enum uart_id id = 0; id < UART_COUNT; id++) {
		stats[id].tx_bytes   = 0;
		stats[id].tx_messages = 0;
		stats[id].dropped    = 0;
		stats[id].start_time = 0;
		stats[id].baudrate   = 0;
	}
}

void stats_record_tx(enum uart_id id, size_t bytes)
{
	if (id >= UART_COUNT) {
		return;
	}

	struct stats_entry *e = &stats[id];

	if (e->tx_messages == 0) {
		e->start_time = k_uptime_get();
	}

	e->tx_messages++;
	e->tx_bytes += bytes;
}

void stats_record_drop(enum uart_id id)
{
	if (id >= UART_COUNT) {
		return;
	}

	stats[id].dropped++;
}

void stats_print_all(void)
{
	printk("%-12s %-12s %-12s %-12s %-12s\n",
	       "UART", "TX bytes", "TX msgs", "Dropped", "Baudrate");

	for (enum uart_id id = 0; id < UART_COUNT; id++) {
		const struct stats_entry *e = &stats[id];
		const struct uart_port *port = uart_get(id);
		const char *label = (port != NULL) ? port->label : "???";

		printk("%-12s %-12llu %-12llu %-12llu %-12u\n",
		       label,
		       (unsigned long long)e->tx_bytes,
		       (unsigned long long)e->tx_messages,
		       (unsigned long long)e->dropped,
		       e->baudrate);
	}
}

void stats_print(enum uart_id id)
{
	if (id >= UART_COUNT) {
		return;
	}

	const struct stats_entry *e = &stats[id];
	const struct uart_port *port = uart_get(id);
	const char *label = (port != NULL) ? port->label : "???";
	uint32_t active_ms = 0;

	if (e->start_time != 0) {
		active_ms = k_uptime_get() - e->start_time;
	}

	printk("%s statistics:\n", label);
	printk("  TX bytes:    %llu\n", (unsigned long long)e->tx_bytes);
	printk("  TX messages: %llu\n", (unsigned long long)e->tx_messages);
	printk("  Dropped:     %llu\n", (unsigned long long)e->dropped);
	printk("  Active time: %us\n", active_ms / 1000U);
	printk("  Baudrate:    %u\n", e->baudrate);
}

void stats_update_baud(enum uart_id id, uint32_t baud)
{
	if (id >= UART_COUNT) {
		return;
	}

	stats[id].baudrate = baud;
}
```

## src/statistics.h
```c
/*
 * SPDX-License-Identifier: Apache-2.0
 *
 * Per-UART runtime statistics.
 */

#ifndef STATISTICS_H
#define STATISTICS_H

#include <stdint.h>
#include <stddef.h>

#include "uart_manager.h"

#ifdef __cplusplus
extern "C" {
#endif

/**
 * @brief Initialise all per-UART statistics counters to zero.
 *
 * Must be called once before any other stats function.
 */
void stats_init(void);

/**
 * @brief Record a successful TX transmission.
 *
 * Increments tx_messages and tx_bytes.  On the very first call for a
 * given UART (when tx_messages was zero) the current uptime is captured
 * as the port's start time.
 *
 * @param id    Logical UART identifier.
 * @param bytes Number of bytes transmitted.
 */
void stats_record_tx(enum uart_id id, size_t bytes);

/**
 * @brief Record a failed TX attempt.
 *
 * Increments the dropped counter for the given UART.
 *
 * @param id  Logical UART identifier.
 */
void stats_record_drop(enum uart_id id);

/**
 * @brief Print an aggregate statistics table for all UARTs.
 *
 * Output format (via printk):
 *   UART        TX bytes    TX msgs     Dropped     Baudrate
 *   USART1      1234567     12345       0           115200
 *   ...
 */
void stats_print_all(void);

/**
 * @brief Print detailed statistics for a single UART.
 *
 * Output format (via printk):
 *   USART1 statistics:
 *     TX bytes:    1234567
 *     TX messages: 12345
 *     Dropped:     0
 *     Active time: 123s
 *     Baudrate:    115200
 *
 * @param id  Logical UART identifier.
 */
void stats_print(enum uart_id id);

/**
 * @brief Update the tracked baudrate for a UART.
 *
 * Called by the shell/control layer whenever the baud rate changes.
 *
 * @param id   Logical UART identifier.
 * @param baud Current baud rate in bps.
 */
void stats_update_baud(enum uart_id id, uint32_t baud);

#ifdef __cplusplus
}
#endif

#endif /* STATISTICS_H */
```

## src/uart_manager.c
```c
/*
 * SPDX-License-Identifier: Apache-2.0
 *
 * UART Manager — logical abstraction for generator UARTs
 */

#include "uart_manager.h"

#include <errno.h>
#include <zephyr/devicetree.h>
#include <zephyr/drivers/uart.h>
#include <zephyr/sys/printk.h>

/* ------------------------------------------------------------------
 * Port table — statically allocated, indexed by enum uart_id
 * ------------------------------------------------------------------ */
static struct uart_port ports[UART_COUNT];

static const char * const port_labels[UART_COUNT] = {
	[UART_GEN1] = "USART1",
	[UART_GEN2] = "USART3",
	[UART_GEN3] = "USART4",
};

/* ------------------------------------------------------------------
 * Helpers
 * ------------------------------------------------------------------ */
static bool id_valid(enum uart_id id)
{
	return (int)id >= 0 && id < UART_COUNT;
}

/* ------------------------------------------------------------------
 * Public API
 * ------------------------------------------------------------------ */

int uart_manager_init(void)
{
	/* Resolve devicetree nodes */
	const struct device *devs[UART_COUNT];

	devs[UART_GEN1] = DEVICE_DT_GET(DT_NODELABEL(usart1));
	devs[UART_GEN2] = DEVICE_DT_GET(DT_NODELABEL(usart3));
	devs[UART_GEN3] = DEVICE_DT_GET(DT_NODELABEL(usart4));

	int failures = 0;
	int ret;

	for (enum uart_id id = UART_GEN1; id < UART_COUNT; id++) {
		const struct device *dev = devs[id];

		ports[id].dev = dev;
		ports[id].label = port_labels[id];
		ports[id].enabled = false;
		ports[id].baudrate = 0;

		if (!device_is_ready(dev)) {
			printk("UART %s: NOT READY\n", port_labels[id]);
			failures++;
			continue;
		}

		/* Read initial configuration to record the baud rate */
		struct uart_config cfg;
		ret = uart_config_get(dev, &cfg);
		if (ret == 0) {
			ports[id].baudrate = cfg.baudrate;
		} else {
			/* Default to 115200 if we can't read config */
			ports[id].baudrate = 115200;
		}

		ports[id].enabled = true;

		printk("UART %s: ready, baud=%u\n",
		       port_labels[id], (unsigned int)ports[id].baudrate);
	}

	return failures ? -EIO : 0;
}

const struct uart_port *uart_get(enum uart_id id)
{
	if (!id_valid(id)) {
		return NULL;
	}
	return &ports[id];
}

int uart_set_baud(enum uart_id id, uint32_t baud)
{
	if (!id_valid(id)) {
		return -EINVAL;
	}

	struct uart_port *port = &ports[id];

	if (!port->enabled || !device_is_ready(port->dev)) {
		return -ENODEV;
	}

	/* Read current config, update baud, write back */
	struct uart_config cfg;
	int ret = uart_config_get(port->dev, &cfg);
	if (ret != 0) {
		return ret;
	}

	cfg.baudrate = baud;

	ret = uart_configure(port->dev, &cfg);
	if (ret != 0) {
		return ret;
	}

	port->baudrate = baud;
	return 0;
}

int uart_enable(enum uart_id id)
{
	if (!id_valid(id)) {
		return -EINVAL;
	}

	ports[id].enabled = device_is_ready(ports[id].dev);
	return 0;
}

int uart_disable(enum uart_id id)
{
	if (!id_valid(id)) {
		return -EINVAL;
	}

	ports[id].enabled = false;
	return 0;
}

int uart_send(enum uart_id id, const uint8_t *buf, size_t len)
{
	if (!id_valid(id)) {
		return -EINVAL;
	}

	const struct uart_port *port = &ports[id];

	if (!port->enabled || !device_is_ready(port->dev)) {
		return -ENODEV;
	}

	int ret = uart_tx(port->dev, buf, len, SYS_FOREVER_MS);
	if (ret != 0) {
		return -EIO;
	}

	return 0;
}
```

## src/uart_manager.h
```c
/*
 * SPDX-License-Identifier: Apache-2.0
 *
 * UART Manager — logical abstraction for generator UARTs
 *
 * Manages three generator UARTs (USART1, USART3, USART4).
 * USART2 (shell/console) is excluded.
 */

#ifndef UART_MANAGER_H
#define UART_MANAGER_H

#include <stdbool.h>
#include <stddef.h>
#include <stdint.h>
#include <zephyr/device.h>

#ifdef __cplusplus
extern "C" {
#endif

/** Logical UART identifiers for the three generator ports. */
enum uart_id {
	UART_GEN1 = 0,	/**< USART1 */
	UART_GEN2,	/**< USART3 */
	UART_GEN3,	/**< USART4 */
	UART_COUNT	/**< Number of generator UARTs */
};

/** Runtime state for a single generator UART port. */
struct uart_port {
	const struct device *dev;	/**< Zephyr device pointer */
	const char *label;		/**< Human-readable label (e.g. "USART1") */
	uint32_t baudrate;		/**< Current baud rate in bps */
	bool enabled;			/**< Port is enabled and usable */
};

/**
 * @brief Initialise the UART manager.
 *
 * Resolves all three generator UARTs from the devicetree, validates
 * readiness, records default baud rates, and marks ports as enabled.
 * Prints per-port status via printk().
 *
 * @retval 0 on success.
 * @retval negative if one or more UARTs could not be resolved or are
 *         not ready (the manager still initialises the working subset).
 */
int uart_manager_init(void);

/**
 * @brief Get a pointer to the port descriptor for a logical UART.
 *
 * @param id  Logical UART identifier.
 *
 * @return Pointer to the @ref uart_port descriptor, or NULL on invalid id.
 */
const struct uart_port *uart_get(enum uart_id id);

/**
 * @brief Change the baud rate of a UART port.
 *
 * Reads the current UART configuration, updates the baud rate, and
 * applies the new configuration via uart_configure().
 *
 * @param id    Logical UART identifier.
 * @param baud  Desired baud rate in bps.
 *
 * @retval 0 on success.
 * @retval -EINVAL if @p id is out of range.
 * @retval -ENODEV if the port is disabled or the device is not ready.
 * @retval negative errno from uart_configure() on failure.
 */
int uart_set_baud(enum uart_id id, uint32_t baud);

/**
 * @brief Enable a UART port.
 *
 * Marks the port as enabled so that uart_send() will accept data.
 *
 * @param id  Logical UART identifier.
 *
 * @retval 0 on success.
 * @retval -EINVAL if @p id is out of range.
 */
int uart_enable(enum uart_id id);

/**
 * @brief Disable a UART port.
 *
 * Marks the port as disabled; uart_send() will return -ENODEV.
 *
 * @param id  Logical UART identifier.
 *
 * @retval 0 on success.
 * @retval -EINVAL if @p id is out of range.
 */
int uart_disable(enum uart_id id);

/**
 * @brief Send data on a UART port.
 *
 * Transmits @p len bytes from @p buf via the UART hardware.
 *
 * @param id  Logical UART identifier.
 * @param buf Pointer to data buffer.
 * @param len Number of bytes to transmit.
 *
 * @retval 0 on success (or positive number of bytes sent).
 * @retval -EINVAL if @p id is out of range.
 * @retval -ENODEV if the port is disabled or device not ready.
 * @retval -EIO if uart_tx() fails.
 */
int uart_send(enum uart_id id, const uint8_t *buf, size_t len);

#ifdef __cplusplus
}
#endif

#endif /* UART_MANAGER_H */
```
