## sdkconfig.defaults
```kconfig
# =============================================================================
# sdkconfig.defaults  -  Waveshare ESP32-S3-LCD-1.47
# ESP32-S3 | 16 MB Flash | 8 MB Octal PSRAM
# =============================================================================

# --- Target ------------------------------------------------------------------
CONFIG_IDF_TARGET="esp32s3"

# --- Flash -------------------------------------------------------------------
CONFIG_ESPTOOLPY_FLASHSIZE_16MB=y
CONFIG_ESPTOOLPY_FLASHSIZE="16MB"

# --- PSRAM (8 MB, octal) -----------------------------------------------------
CONFIG_SPIRAM=y
CONFIG_SPIRAM_USE_MALLOC=y
CONFIG_SPIRAM_MALLOC_ALWAYSINTERNAL=16384
CONFIG_SPIRAM_SPEED_80M=y
CONFIG_SPIRAM_MODE_OCT=y

# --- Console + logging -------------------------------------------------------
# Use USB Serial/JTAG so the built-in USB-C cable provides both flashing
# and console I/O through `espflash monitor`.
CONFIG_ESP_CONSOLE_USB_SERIAL_JTAG=y
# CONFIG_ESP_CONSOLE_UART_DEFAULT is not set
CONFIG_ESP_CONSOLE_SECONDARY_NONE=y

CONFIG_LOG_MAXIMUM_LEVEL=5
CONFIG_LOG_DEFAULT_LEVEL=4

# --- Runtime stack sizing ----------------------------------------------------
CONFIG_ESP_MAIN_TASK_STACK_SIZE=8192
```
